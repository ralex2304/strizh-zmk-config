## boards/shields/strizh/Kconfig.defconfig
```kconfig
if SHIELD_STRIZH_LEFT_7COL

config ZMK_KEYBOARD_NAME
    default "strizh"

config ZMK_SPLIT_ROLE_CENTRAL
    default y

endif

if SHIELD_STRIZH_RIGHT_TRACKPAD

config SPI
    default y

endif

if SHIELD_STRIZH_LEFT_7COL || SHIELD_STRIZH_RIGHT_TRACKPAD

config ZMK_SPLIT
    default y

config ZMK_POINTING
    default y

config ZMK_POINTING_SMOOTH_SCROLLING
    default y

config ZMK_STUDIO
    default y

endif
```

## boards/shields/strizh/Kconfig.shield
```kconfig
config SHIELD_STRIZH_LEFT_7COL
    def_bool $(shields_list_contains,strizh_left_7col)

config SHIELD_STRIZH_RIGHT_TRACKPAD
    def_bool $(shields_list_contains,strizh_right_trackpad)
```

## config/west.yml
```yaml
manifest:
  remotes:
    - name: zmkfirmware
      url-base: https://github.com/zmkfirmware
    - name: petejohanson
      url-base: https://github.com/petejohanson
  projects:
    - name: zmk
      remote: zmkfirmware
      import: app/west.yml
      revision: v0.3
    - name: cirque-input-module
      remote: petejohanson
      path: modules/cirque-input-module
      revision: main
  self:
    path: config
```
